## drivers/hisi/npu_pm/Kconfig
```kconfig
menu "HISI NPU PM Options"

config HISI_NPU_PM
    tristate "Hisilicon NPU Power Management Driver"
    depends on ARCH_HISI
    help
      This enables the hisilicon npu low power driver.

config HISI_NPU_PM_DEBUG
    tristate "Hisilicon NPU Power Management Debug Driver"
    depends on HISI_NPU_PM
    help
      This enables the hisilicon npu low power debug driver.

config HISI_NPUFREQ
    tristate "Hisilicon NPUFREQ Driver Based On Devfreq"
    depends on HISI_NPU_PM
    select PM_OPP
    help
      This enables the hisilicon NPUFREQ Driver Based On Devfreq.

config HISI_NPUFREQ_PM_QOS
    tristate "Hisilicon NPUFREQ PM Qos"
    depends on HISI_NPU_PM
    help
      This enables the hisilicon NPUFREQ PM Qos.

endmenu
```
