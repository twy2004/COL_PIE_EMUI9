/* DO NOT EDIT - Automatically generated by python */
/ {
		sunwodamurata_3550_110k_4416_57:sunwodamurata_3550_110k_4416_57 {
			fcc = <3550>;
			default_rbatt_mohm = <100>;
			identify_type = "id_volt";
			id_identify_min = <2281>;
			id_identify_max = <2786>;
			id_voltage_min = <2426>;
			id_voltage_max = <2631>;
			vbat_max = <4416>;
			temp_para = 
						"-32767","0","-1","0","4100","0",
						"0","5","-1","355","4416","0",
						"5","10","-1","1065","4416","3",
						"10","45","-1","-1","4416","3",
						"45","50","-1","1242","4100","3",
						"50","32767","-1","0","4100","0";
			vbat_para = 
						"-32767","3400","-1","820","0",
						"3400","32767","-1","-1","0";
			segment_para = 
						"-32767","4150","3550","4208","50",
						"4150","4450","2485","4416","0";
			batt_brand = "sunwodamurata";
			fcc_temp = <3497 3534 3561 3547 3522 3497>;
			fcc_sf_x = <0 100 200 300 400 500 600 700 800 1000 1500>;
			fcc_sf_y = <100 96 94 92 90 88 87 84 81 75 50>;
			fcc_sf_cols = <11>;
			pc_sf_rows = <1>;
			pc_sf_cols = <1>;
			pc_sf_row_entries = <0>;
			pc_sf_percent = <100>;
			pc_sf_sf = <100>;
			rbatt_sf_rows = <28>;
			rbatt_sf_cols = <6>;
			rbatt_sf_percent = <100 95 90 85 80 75 70 65 60 55 50 45 40 35 30 25 20 15 10 9 8 7 6 5 4 3 2 1>;
			rbatt_sf_sf = <
			               1670 826 428 144 120 115
			               1659 831 435 146 121 115
			               1625 828 441 148 123 116
			               1586 820 447 152 125 116
			               1545 803 446 157 128 118
			               1514 800 451 165 132 119
			               1493 789 444 173 139 123
			               1479 781 427 181 148 130
			               1470 779 414 165 141 127
			               1470 785 408 145 125 117
			               1478 793 413 141 120 113
			               1508 803 419 143 121 113
			               1563 829 427 147 123 115
			               1628 867 439 150 128 120
			               1713 914 461 151 125 116
			               1832 972 487 145 121 114
			               2006 1053 518 145 123 117
			               2250 1206 564 147 126 116
			               3350 1440 530 148 127 121
			               3697 1547 546 149 128 122
			               4066 1686 575 149 130 124
			               4437 1801 604 153 132 128
			               4872 1982 650 158 131 123
			               5438 2275 746 162 131 119
			               6288 2661 831 166 132 126
			               7710 3243 987 179 139 128
			               10725 4254 1371 198 150 132
			               16819 5931 2109 237 165 148
			              >;
			pc_temp_ocv_rows = <29>;
			pc_temp_ocv_cols = <6>;
			pc_temp_ocv_percent = <100 95 90 85 80 75 70 65 60 55 50 45 40 35 30 25 20 15 10 9 8 7 6 5 4 3 2 1>;
			pc_temp_ocv_ocv = <
			                   4358 4368 4370 4365 4358 4352
			                   4284 4302 4310 4308 4301 4295
			                   4216 4240 4251 4249 4243 4238
			                   4152 4178 4191 4191 4185 4180
			                   4090 4115 4130 4134 4129 4125
			                   4034 4059 4075 4079 4075 4072
			                   3980 4001 4017 4028 4026 4023
			                   3930 3950 3962 3980 3979 3977
			                   3886 3905 3915 3929 3929 3929
			                   3848 3869 3875 3884 3884 3883
			                   3815 3836 3844 3851 3851 3850
			                   3790 3808 3817 3826 3825 3824
			                   3771 3788 3795 3805 3805 3803
			                   3753 3772 3778 3787 3788 3785
			                   3736 3757 3765 3770 3767 3759
			                   3718 3739 3750 3750 3743 3732
			                   3699 3716 3729 3730 3722 3710
			                   3677 3687 3700 3702 3695 3682
			                   3647 3659 3667 3675 3670 3658
			                   3637 3651 3662 3671 3666 3654
			                   3629 3643 3655 3665 3661 3650
			                   3616 3631 3646 3656 3654 3643
			                   3599 3620 3635 3641 3641 3629
			                   3577 3603 3617 3613 3613 3599
			                   3550 3572 3579 3566 3570 3556
			                   3505 3522 3521 3508 3515 3502
			                   3444 3447 3443 3432 3445 3433
			                   3357 3349 3337 3335 3349 3339
			                   3200 3200 3200 3200 3200 3200
			                  >;
		};
};
